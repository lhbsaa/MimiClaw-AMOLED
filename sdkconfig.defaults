## sdkconfig.defaults
```kconfig
# MimiClaw AMOLED Configuration
# ESP32-S3 with RM67162 AMOLED Display

# Target Chip
CONFIG_IDF_TARGET="esp32s3"

# CPU Frequency
CONFIG_ESP_DEFAULT_CPU_FREQ_MHZ_240=y

# SPIRAM Configuration
CONFIG_SPIRAM=y
CONFIG_SPIRAM_MODE_OCT=y
CONFIG_SPIRAM_SPEED_80M=y
CONFIG_SPIRAM_USE_CAPS_ALLOC=y
CONFIG_SPIRAM_USE_MALLOC=y

# Flash Configuration
CONFIG_ESPTOOLPY_FLASHMODE_QIO=y
CONFIG_ESPTOOLPY_FLASHFREQ_80M=y

# SNTP Configuration
CONFIG_LWIP_SNTP_MAX_SERVERS=3
CONFIG_LWIP_SNTP_UPDATE_DELAY=3600000
# CONFIG_LWIP_SNTP_STARTUP_DELAY is not set

# FreeRTOS
CONFIG_FREERTOS_HZ=1000
CONFIG_FREERTOS_UNICORE=n
CONFIG_FREERTOS_NUMBER_OF_CORES=2

# WiFi - buffer sizes are set in sdkconfig.defaults.esp32s3 (memory-optimized for PSRAM)

# HTTP Client
CONFIG_ESP_HTTP_CLIENT_ENABLE_HTTPS=y

# Log Level
CONFIG_LOG_DEFAULT_LEVEL_INFO=y
CONFIG_LOG_MAXIMUM_LEVEL_DEBUG=y

# Console - deferred to sdkconfig.defaults.esp32s3 to avoid conflict
# (esp32s3 file sets UART_DEFAULT + secondary USB Serial/JTAG)

# ESP Timer - Increase task stack for battery/ADC operations
CONFIG_ESP_TIMER_TASK_STACK_SIZE=8192

# FreeRTOS Timer Task - Fix stack overflow
CONFIG_FREERTOS_TIMER_TASK_STACK_DEPTH=4096

# Task Watchdog Timer - Longer timeout for slow LLM calls
CONFIG_ESP_TASK_WDT_TIMEOUT_S=30
```
